## arch/arm64/configs/exynos9610-a50s_recovery_defconfig
```kconfig
CONFIG_MINT_PLATFORM_VERSION=12
CONFIG_-ANDROID_BOOT_PARTITION "/dev/sda14"
CONFIG_-BLK_DEV_THROTTLING y
CONFIG_-BLK_DEV_THROTTLING_LOW y
CONFIG_-BPF_JIT_ALWAYS_ON y
CONFIG_-CFI_CLANG n
CONFIG_-CFQ_GROUP_IOSCHED y
CONFIG_-CGROUP_WRITEBACK y
CONFIG_-CMDLINE_EXTEND y
CONFIG_-CMDLINE_FORCE n
CONFIG_-CMDLINE_FROM_BOOTLOADER n
CONFIG_-CRYPTO_NHPOLY1305 y
CONFIG_-DEBUG_BLK_CGROUP n
CONFIG_-DEFAULT_ANXIETY n
CONFIG_-DEFAULT_BBR n
CONFIG_-DEFAULT_BIC n
CONFIG_-DEFAULT_CUBIC n
CONFIG_-DEFAULT_FIOPS n
CONFIG_-DEFAULT_HTCP n
CONFIG_-DEFAULT_RENO n
CONFIG_-DEFAULT_SIO n
CONFIG_-DEFAULT_WESTWOOD y
CONFIG_-DEFAULT_ZEN n
CONFIG_-DEVFREQ_DECON_BOOST_DURATION_MS 70
CONFIG_-DEVFREQ_EXYNOS_MIF_BOOST_FREQ 1539000
CONFIG_-DEVFREQ_MIF_BOOST_DURATION_MS 100
CONFIG_-DEVFREQ_WAKE_BOOST_DURATION_MS 1000
CONFIG_-ENERGY_ADAPTIVE_DOWN_RATE_LIMIT_FAST 8000
CONFIG_-ENERGY_ADAPTIVE_DOWN_RATE_LIMIT_SLOW 8000
CONFIG_-ENERGY_ADAPTIVE_UP_RATE_LIMIT_FAST 4000
CONFIG_-ENERGY_ADAPTIVE_UP_RATE_LIMIT_SLOW 4000
CONFIG_-EROFS_FS_DEBUG n
CONFIG_-EROFS_FS_PCPU_KTHREAD y
CONFIG_-EROFS_FS_PCPU_KTHREAD_HIPRI y
CONFIG_-EROFS_FS_POSIX_ACL y
CONFIG_-EROFS_FS_SECURITY y
CONFIG_-EROFS_FS_XATTR y
CONFIG_-EROFS_FS_ZIP y
CONFIG_-EXPORTFS y
CONFIG_-LZ4_COMPRESS y
CONFIG_-MAX_DIRTY_THRESH_PAGES 25600
CONFIG_-NTFS_DEBUG n
CONFIG_-NTFS_RW y
CONFIG_-OVERLAY_FS_INDEX n
CONFIG_-OVERLAY_FS_REDIRECT_DIR n
CONFIG_-PLAYSTATION_FF y
CONFIG_-PSI_DEFAULT_DISABLED n
CONFIG_-RCU_BOOST n
CONFIG_-RCU_FANOUT 64
CONFIG_-RCU_FANOUT_LEAF 16
CONFIG_-RCU_FAST_NO_HZ y
CONFIG_-RCU_NOCB_CPU y
CONFIG_-RELR y
CONFIG_-SND_SOC_WM_ADSP y
CONFIG_-TCP_CONG_BBR y
CONFIG_-TCP_CONG_BIC y
CONFIG_-TCP_CONG_CDG n
CONFIG_-TCP_CONG_DCTCP n
CONFIG_-TCP_CONG_HSTCP n
CONFIG_-TCP_CONG_HTCP y
CONFIG_-TCP_CONG_HYBLA n
CONFIG_-TCP_CONG_LP n
CONFIG_-TCP_CONG_NV n
CONFIG_-TCP_CONG_SCALABLE n
CONFIG_-TCP_CONG_VEGAS n
CONFIG_-TCP_CONG_VENO n
CONFIG_-TCP_CONG_WESTWOOD y
CONFIG_-TCP_CONG_YEAH n
CONFIG_-THINLTO n
CONFIG_-UCLAMP_ASSIST y
CONFIG_-UCLAMP_BUCKETS_COUNT 20
CONFIG_-UCLAMP_TASK_GROUP y
CONFIG_-USB_F_MASS_STORAGE y
CONFIG_-USB_F_SS_MON_GADGET y
CONFIG_-WAKELOCKS_TIMEOUT 750
CONFIG_-WIREGUARD_DEBUG n
CONFIG_-ZRAM_DEF_COMP_LZ4 y
CONFIG_-ZRAM_ENTROPY_THRESHOLD 90000
CONFIG_-ZRAM_LRU_WRITEBACK y
CONFIG_-ZRAM_LRU_WRITEBACK_LIMIT 5120
CONFIG_ ALWAYS_ENFORCE n =y
CONFIG_ ANDROID_LOW_MEMORY_KILLER n =y
CONFIG_ ANDROID_SAR_RAMDISK y =n
CONFIG_ ARM64_ERRATUM_1024718 n =y
CONFIG_ ARM64_ERRATUM_819472 n =y
CONFIG_ ARM64_ERRATUM_824069 n =y
CONFIG_ ARM64_ERRATUM_826319 n =y
CONFIG_ ARM64_ERRATUM_827319 n =y
CONFIG_ ARM64_ERRATUM_832075 n =y
CONFIG_ ARM64_SW_TTBR0_PAN n =y
CONFIG_ ARM_EXYNOS_DEVFREQ_DEBUG n =y
CONFIG_ AUDIT n =y
CONFIG_ BIG_CPU_MASK 240 =
CONFIG_ BLK_CGROUP y =n
CONFIG_ BLK_DEV_LOOP_MIN_COUNT 32 =8
CONFIG_ BLOCK_SUPPORT_STLOG n =y
CONFIG_ BOEFFLA_WL_BLOCKER y =n
CONFIG_ BPF_JIT y =n
CONFIG_ CAVIUM_ERRATUM_22375 n =y
CONFIG_ CAVIUM_ERRATUM_23154 n =y
CONFIG_ CAVIUM_ERRATUM_27456 n =y
CONFIG_ CAVIUM_ERRATUM_30115 n =y
CONFIG_ CC_OPTIMIZE_FOR_PERFORMANCE_O3 y =n
CONFIG_ CC_OPTIMIZE_FOR_SIZE n =y
CONFIG_ CFS_BANDWIDTH n =y
CONFIG_ CMDLINE "quiet androidboot.init_fatal_panic=true androidboot.init_fatal_reboot_target=recovery rcu_nocbs=0-3 noirqdebug nosoftlockup mce=ignore_ce cgroup_disable=pressure" =""
CONFIG_ CMUCAL_DEBUG n =y
CONFIG_ COMPAT_VDSO y =n
CONFIG_ CONTEXTHUB_DEBUG n =y
CONFIG_ CPU_FREQ_DEFAULT_GOV_ENERGY_ADAPTIVE y =n
CONFIG_ CPU_FREQ_DEFAULT_GOV_SCHEDUTIL n =y
CONFIG_ CPU_FREQ_GOV_ENERGY_ADAPTIVE y =n
CONFIG_ CP_RAM_LOGGING n =y
CONFIG_ CRYPTO_ADIANTUM y =n
CONFIG_ CRYPTO_CHACHA20 y =n
CONFIG_ CRYPTO_CHACHA20POLY1305 y =n
CONFIG_ CRYPTO_DISKCIPHER_DEBUG n =y
CONFIG_ CRYPTO_LZ4 y =n
CONFIG_ CRYPTO_POLY1305 y =n
CONFIG_ DEBUG_KERNEL n =y
CONFIG_ DEBUG_SNAPSHOT_LOGGING_SMC n =y
CONFIG_ DEFAULT_MNT_NOATIME y =n
CONFIG_ DEFAULT_MNT_RELATIME n =y
CONFIG_ DEFAULT_TCP_CONG "westwood" ="cubic"
CONFIG_ DEVFREQ_BOOST y =n
CONFIG_ DEVFREQ_THERMAL y =n
CONFIG_ EROFS_FS y =n
CONFIG_ EXYNOS_CORESIGHT n =y
CONFIG_ EXYNOS_FMP n =y
CONFIG_ EXYNOS_ITMON n =y
CONFIG_ FAST_TRACK n =y
CONFIG_ FAULT_AROUND_4KB y =n
CONFIG_ FIVE n =y
CONFIG_ FSL_ERRATUM_A008585 n =y
CONFIG_ GAF_V3 y =n
CONFIG_ GAF_V6 n =y
CONFIG_ HID_PLAYSTATION y =n
CONFIG_ HISILICON_ERRATUM_161010101 n =y
CONFIG_ HZ 300 =250
CONFIG_ HZ_250 n =y
CONFIG_ HZ_300 y =n
CONFIG_ INCREMENTAL_FS y =n
CONFIG_ INITRAMFS_SKIP n =y
CONFIG_ INLINE_OPTIMIZATION y =n
CONFIG_ INTEGRITY_SIGNATURE n =y
CONFIG_ IOSCHED_ANXIETY y =n
CONFIG_ IOSCHED_FIOPS y =n
CONFIG_ IOSCHED_SIO y =n
CONFIG_ IOSCHED_ZEN y =n
CONFIG_ LARGE_DIRTY_BUFFER y =n
CONFIG_ LARGE_TCP_INITIAL_BUFFER y =n
CONFIG_ LD_DEAD_CODE_DATA_ELIMINATION y =n
CONFIG_ LD_LLD y =n
CONFIG_ LITTLE_CPU_MASK 15 =
CONFIG_ LLVM_POLLY y =n
CONFIG_ LOCALVERSION_AUTO n =y
CONFIG_ LOG_BUF_SHIFT 20 =21
CONFIG_ LOG_CPU_MAX_BUF_SHIFT 0 =12
CONFIG_ LTO n
CONFIG_ LTO_n
CONFIG_ LTO_NONE y
CONFIG_ MALI_MIDGARD n =y
CONFIG_ MFD_CS35L41 y =n
CONFIG_ MFD_CS35L41_SPI y =n
CONFIG_ MMAP_READAROUND_LIMIT 16 =0
CONFIG_ MMC_DW_DEBUG n =y
CONFIG_ MMC_SUPPORT_STLOG n =y
CONFIG_ MST_LDO y =n
CONFIG_ MST_SUPPORT_GPIO y =n
CONFIG_ MST_TEEGRIS y =n
CONFIG_ NETFILTER_XT_MATCH_QUOTA2_LOG n =y
CONFIG_ NETFILTER_XT_TARGET_LOG n =y
CONFIG_ NET_SUPPORT_DROPDUMP n =y
CONFIG_ NFC_PN547 n =y
CONFIG_ NTFS_FS y =n
CONFIG_ OPTIMIZE_INLINING y =n
CONFIG_ OVERLAY_FS y =n
CONFIG_ PELT_UTIL_HALFLIFE_16 n =y
CONFIG_ PELT_UTIL_HALFLIFE_8 y =n
CONFIG_ PM_AUTOSLEEP n =y
CONFIG_ PM_DEBUG n =y
CONFIG_ PM_WAKELOCKS_GC y =n
CONFIG_ PROC_MAGISK_HIDE_MOUNT y =n
CONFIG_ PROC_SPOOF_CMDLINE y =n
CONFIG_ PSI y =n
CONFIG_ QCOM_FALKOR_ERRATUM_1003 n =y
CONFIG_ QCOM_FALKOR_ERRATUM_1009 n =y
CONFIG_ QCOM_FALKOR_ERRATUM_E1041 n =y
CONFIG_ QCOM_QDF2400_ERRATUM_0065 n =y
CONFIG_ RCU_EXPERT y =n
CONFIG_ REAP_ON_SIGKILL_DEFAULT y =n
CONFIG_ REFCOUNT_FULL n =y
CONFIG_ RT_REGMAP n =y
CONFIG_ SCSC_AP_INTERFACE_NAME "wlan1" ="swlan0"
CONFIG_ SCSC_QOS y =n
CONFIG_ SCSC_WLBTD n =y
CONFIG_ SDFAT_DEBUG n =y
CONFIG_ SDP n =y
CONFIG_ SECURITY_DEFEX n =y
CONFIG_ SECURITY_DSMS n =y
CONFIG_ SECURITY_SELINUX_SWITCH y =n
CONFIG_ SEC_BOOTSTAT n =y
CONFIG_ SEC_NFC y =n
CONFIG_ SEC_SND_SYNCHRONIZED_IPC y =n
CONFIG_ SEC_SND_SYNCHRONIZED_IPC_RICHTEK n =y
CONFIG_ SENSORS_SSP_A50 y =n
CONFIG_ SENSORS_SSP_A50S n =y
CONFIG_ SENSORS_SSP_ACCELOMETER_ICM42605M y =n
CONFIG_ SENSORS_SSP_ACCELOMETER_LSM6DSL n =y
CONFIG_ SENSORS_SSP_GYROFILE_FOR_MAG y =n
CONFIG_ SENSORS_SSP_GYROSCOPE_ICM42605M y =n
CONFIG_ SENSORS_SSP_GYROSCOPE_LSM6DSL n =y
CONFIG_ SENSORS_SX9360 n =y
CONFIG_ SENSORS_SX9360_SUB n =y
CONFIG_ SENSORS_TC3XXK y =n
CONFIG_ SLUB_CPU_PARTIAL n =y
CONFIG_ SLUB_DEBUG n =y
CONFIG_ SND_RICHTEK_SPM n =y
CONFIG_ SND_SOC_CS35L41 y =n
CONFIG_ SND_SOC_RT5510 n =y
CONFIG_ SUPPORT_POC_FLASH y =n
CONFIG_ SUSPEND_SKIP_SYNC y =n
CONFIG_ TCP_CONG_ADVANCED y =n
CONFIG_ TOOLS_SUPPORT_RELR y =n
CONFIG_ TZIC n =y
CONFIG_ TZLOG n =y
CONFIG_ UCLAMP_TASK y =n
CONFIG_ UH n =y
CONFIG_ UH_LKMAUTH n =y
CONFIG_ UH_LKM_BLOCK n =y
CONFIG_ USB_CONFIGFS_F_SS_MON_GADGET y =n
CONFIG_ USB_CONFIGFS_MASS_STORAGE y =n
CONFIG_ USB_DEBUG_DETAILED_LOG n =y
CONFIG_ USB_NET_CDC_MBIM n =y
CONFIG_ USB_WDM n =y
CONFIG_ VMSTAT_INTERVAL 10 =15
CONFIG_ WAKELOCKS_DEFAULT_TIMEOUT y =n
CONFIG_ WIREGUARD y =n
CONFIG_ WQ_POWER_EFFICIENT_DEFAULT y =n
CONFIG_ ZRAM_DEF_COMP "lz4" ="lzo"
CONFIG_ ZRAM_DEF_COMP_LZO n =y
CONFIG_ ZRAM_ENTROPY y =n
CONFIG_ ZRAM_WRITEBACK y =n
CONFIG_+ARM64_PTDUMP_DEBUGFS n
CONFIG_+AUDITSYSCALL y
CONFIG_+AUDIT_COMPAT_GENERIC y
CONFIG_+AUDIT_GENERIC y
CONFIG_+AUDIT_TREE y
CONFIG_+AUDIT_WATCH y
CONFIG_+BACKTRACE_SELF_TEST n
CONFIG_+BOOTPARAM_HARDLOCKUP_PANIC y
CONFIG_+BOOTPARAM_HARDLOCKUP_PANIC_VALUE 1
CONFIG_+BOOTPARAM_HUNG_TASK_PANIC y
CONFIG_+BOOTPARAM_HUNG_TASK_PANIC_VALUE 1
CONFIG_+BOOTPARAM_SOFTLOCKUP_PANIC y
CONFIG_+BOOTPARAM_SOFTLOCKUP_PANIC_VALUE 1
CONFIG_+BOOT_PRINTK_DELAY n
CONFIG_+CGROUP_DEBUG y
CONFIG_+CMA_DEBUG n
CONFIG_+CPU_HOTPLUG_STATE_CONTROL n
CONFIG_+CRYPTO_DEV_FMP y
CONFIG_+DEBUG_ATOMIC_SLEEP y
CONFIG_+DEBUG_BLOCK_EXT_DEVT n
CONFIG_+DEBUG_CREDENTIALS n
CONFIG_+DEBUG_DEVRES n
CONFIG_+DEBUG_DRIVER n
CONFIG_+DEBUG_FORCE_WEAK_PER_CPU n
CONFIG_+DEBUG_GPIO n
CONFIG_+DEBUG_INFO y
CONFIG_+DEBUG_INFO_DWARF4 n
CONFIG_+DEBUG_INFO_REDUCED n
CONFIG_+DEBUG_INFO_SPLIT n
CONFIG_+DEBUG_KMEMLEAK n
CONFIG_+DEBUG_KOBJECT n
CONFIG_+DEBUG_LIST n
CONFIG_+DEBUG_LOCKING_API_SELFTESTS n
CONFIG_+DEBUG_LOCK_ALLOC n
CONFIG_+DEBUG_MUTEXES n
CONFIG_+DEBUG_NOTIFIERS n
CONFIG_+DEBUG_OBJECTS n
CONFIG_+DEBUG_PAGEALLOC n
CONFIG_+DEBUG_PAGE_REF n
CONFIG_+DEBUG_PERF_USE_VMALLOC n
CONFIG_+DEBUG_PER_CPU_MAPS n
CONFIG_+DEBUG_PINCTRL n
CONFIG_+DEBUG_PI_LIST n
CONFIG_+DEBUG_PREEMPT n
CONFIG_+DEBUG_RT_MUTEXES n
CONFIG_+DEBUG_SG n
CONFIG_+DEBUG_SHIRQ n
CONFIG_+DEBUG_SPINLOCK n
CONFIG_+DEBUG_STACK_USAGE n
CONFIG_+DEBUG_TEST_DRIVER_REMOVE n
CONFIG_+DEBUG_VIRTUAL n
CONFIG_+DEBUG_VM n
CONFIG_+DEBUG_WQ_FORCE_RR_CPU n
CONFIG_+DEBUG_WW_MUTEX_SLOWPATH n
CONFIG_+DEFAULT_HUNG_TASK_TIMEOUT 120
CONFIG_+DEFEX_KERNEL_ONLY n
CONFIG_+DETECT_HUNG_TASK y
CONFIG_+DPM_WATCHDOG n
CONFIG_+EXYNOS_CORESIGHT_MAINTAIN_DBG_REG n
CONFIG_+EXYNOS_CORESIGHT_PC_INFO y
CONFIG_+EXYNOS_FMP_FIPS y
CONFIG_+EXYNOS_SOC_NAME "9610"
CONFIG_+FAULT_INJECTION n
CONFIG_+FIVE_CERT_USER "x509_five_user.der"
CONFIG_+FIVE_DEBUG n
CONFIG_+FIVE_DEFAULT_HASH "sha1"
CONFIG_+FIVE_DEFAULT_HASH_SHA1 y
CONFIG_+FIVE_DEFAULT_HASH_SHA256 n
CONFIG_+FIVE_DEFAULT_HASH_SHA512 n
CONFIG_+FIVE_EARLY_LOAD_TRUSTED_APP n
CONFIG_+FIVE_GKI_10 n
CONFIG_+FIVE_GKI_20 n
CONFIG_+FIVE_TEE_DRIVER y
CONFIG_+FIVE_USE_EMULATOR n
CONFIG_+FIVE_USE_TZDEV y
CONFIG_+FSCRYPT_SDP y
CONFIG_+GDB_SCRIPTS n
CONFIG_+GPU_TRACEPOINTS y
CONFIG_+HARDLOCKUP_DETECTOR_OTHER_CPU y
CONFIG_+ICD y
CONFIG_+ICD_USE_TZDEV y
CONFIG_+INTEGRITY_ASYMMETRIC_KEYS y
CONFIG_+INTEGRITY_AUDIT y
CONFIG_+INTERVAL_TREE_TEST n
CONFIG_+KALLSYMS_ALL y
CONFIG_+KGDB n
CONFIG_+LATENCYTOP n
CONFIG_+LD_BFD y
CONFIG_+LOCKUP_DETECTOR y
CONFIG_+LOCK_STAT n
CONFIG_+LOCK_TORTURE_TEST n
CONFIG_+MALI_2MB_ALLOC n
CONFIG_+MALI_ARBITER_SUPPORT n
CONFIG_+MALI_CORESTACK n
CONFIG_+MALI_DEBUG n
CONFIG_+MALI_DEBUG_KERNEL_SYSFS y
CONFIG_+MALI_DEBUG_SYS y
CONFIG_+MALI_DEVFREQ n
CONFIG_+MALI_DMA_BUF_LEGACY_COMPAT n
CONFIG_+MALI_DMA_BUF_MAP_ON_DEMAND n
CONFIG_+MALI_DMA_FENCE n
CONFIG_+MALI_EXPERT y
CONFIG_+MALI_EXYNOS_SECURE_RENDERING_ARM n
CONFIG_+MALI_EXYNOS_SECURE_RENDERING_LEGACY n
CONFIG_+MALI_EXYNOS_TRACE y
CONFIG_+MALI_FENCE_DEBUG y
CONFIG_+MALI_FTRACE_FREQ n
CONFIG_+MALI_GATOR_SUPPORT y
CONFIG_+MALI_GEM5_BUILD n
CONFIG_+MALI_HW_ERRATA_1485982_NOT_AFFECTED n
CONFIG_+MALI_HW_ERRATA_1485982_USE_CLOCK_ALTERNATIVE n
CONFIG_+MALI_JOB_DUMP n
CONFIG_+MALI_MEMORY_FULLY_BACKED n
CONFIG_+MALI_MIDGARD_DVFS n
CONFIG_+MALI_MIDGARD_ENABLE_TRACE n
CONFIG_+MALI_NO_MALI n
CONFIG_+MALI_PLATFORM_THIRDPARTY_NAME "exynos"
CONFIG_+MALI_PRFCNT_SET_SECONDARY n
CONFIG_+MALI_PRFCNT_SET_SECONDARY_VIA_DEBUG_FS n
CONFIG_+MALI_PWRSOFT_765 n
CONFIG_+MALI_SEC_JOB_STATUS_CHECK n
CONFIG_+MALI_SUSTAINABLE_OPT n
CONFIG_+MALI_SYSTEM_TRACE n
CONFIG_+MMC_DW_EXYNOS_FMP n
CONFIG_+NETFILTER_XT_TARGET_AUDIT n
CONFIG_+NFC_PN547_CLK_BBCLK2 n
CONFIG_+NFC_PN547_ESE_SUPPORT n
CONFIG_+NFC_PN547_LDO_CONTROL n
CONFIG_+NODE_FOR_SELFTEST_FAIL n
CONFIG_+NOTIFIER_ERROR_INJECTION n
CONFIG_+PAGE_OWNER n
CONFIG_+PANIC_FOR_SELFTEST_FAIL y
CONFIG_+PC_ITERATION 5
CONFIG_+PERCPU_TEST n
CONFIG_+PM_ADVANCED_DEBUG n
CONFIG_+PM_SLEEP_DEBUG y
CONFIG_+PM_TEST_SUSPEND n
CONFIG_+PROCA y
CONFIG_+PROCA_GKI_10 n
CONFIG_+PROCA_S_OS n
CONFIG_+PROVE_LOCKING n
CONFIG_+RANDOMIZE_MODULE_REGION_FULL y
CONFIG_+RBTREE_TEST n
CONFIG_+RCU_EQS_DEBUG n
CONFIG_+RCU_PERF_TEST n
CONFIG_+RCU_TORTURE_TEST n
CONFIG_+RCU_TRACE n
CONFIG_+READABLE_ASM n
CONFIG_+RKP_DMAP_PROT y
CONFIG_+RKP_KDP y
CONFIG_+RKP_NS_PROT y
CONFIG_+SCHEDSTATS y
CONFIG_+SCHED_DEBUG y
CONFIG_+SCHED_STACK_END_CHECK n
CONFIG_+SCSC_WRITE_INFO_FILE_WLBTD y
CONFIG_+SCSI_UFS_EXYNOS_FMP y
CONFIG_+SDFAT_DBG_BUGON n
CONFIG_+SDFAT_DBG_IOCTL n
CONFIG_+SDFAT_DBG_MSG y
CONFIG_+SIGNATURE y
CONFIG_+SLABINFO y
CONFIG_+SLUB_DEBUG_ON n
CONFIG_+SOFTLOCKUP_DETECTOR y
CONFIG_+SPI_DEBUG n
CONFIG_+TEE_DRIVER_DEBUG n
CONFIG_+TZIC_DEFAULT n
CONFIG_+TZIC_USE_TZDEV y
CONFIG_+TZLOG_PG_CNT 8
CONFIG_+TZLOG_POLLING n
CONFIG_+UH_DEBUG n
CONFIG_+UH_RKP y
CONFIG_+UH_RKP_FIMC_CHECK n
CONFIG_+USB_GADGET_DEBUG n
CONFIG_+WQ_WATCHDOG y
```
